## Kconfig
```kconfig
menuconfig CISTEME_BME280
    bool "Enable CISTEME Custom BME280 driver"
    default y
    depends on DT_HAS_CISTEME_BME280_ENABLED
    select I2C
    help
      Simple BME280 reading driver
```

## dts/bindings/cisteme,bme280.yaml
```yaml
description: "CISTEME BME280 Custom Driver"

compatible: "cisteme,bme280"

include: [i2c-device.yaml]
```
